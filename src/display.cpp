#include "display.h"

#include <Arduino.h>
#include <Wire.h>
#include <Adafruit_GFX.h>
#include <Adafruit_SH110X.h>
#include <Adafruit_SSD1306.h>

#include "azimuth.h"
#include "buttons.h"
#include "config.h"
#include "errors.h"
#include "motor.h"
#include "pulse.h"
#include "uart_link.h"

namespace {
bool displayReady = false;
uint32_t lastDisplayRefreshMs = 0;
uint32_t splashStartedMs = 0;
uint32_t lastDisplayActivityMs = 0;
bool splashActive = false;
bool displaySleeping = false;

#if (CONFIG_OLED_1306 == 1)
Adafruit_SSD1306 display(OLED_WIDTH, OLED_HEIGHT, &Wire, -1);
#endif

#if (CONFIG_OLED_1106 == 1)
Adafruit_SH1106G display(OLED_WIDTH, OLED_HEIGHT, &Wire, -1);
#endif

// const unsigned char logoBitmap[] PROGMEM = {
//   0xff, 0xff, 0xff, 0xff, 0xff, 0xff, 0xff, 0xff, 0xff, 0xff, 0x80, 0x00, 0x00, 0x01, 0xff, 0xff,
//   0xff, 0xff, 0x80, 0x00, 0x00, 0x01, 0xff, 0xff, 0xff, 0xff, 0xc0, 0x00, 0x00, 0x03, 0xff, 0xff,
//   0xff, 0xff, 0xc0, 0x00, 0x00, 0x03, 0xff, 0xff, 0xff, 0xff, 0xe0, 0x00, 0x00, 0x07, 0xff, 0xff,
//   0xff, 0xff, 0xe0, 0x00, 0x00, 0x07, 0xff, 0xff, 0xff, 0xff, 0xf0, 0x00, 0x00, 0x0f, 0xff, 0xff,
//   0xff, 0xff, 0xf0, 0x00, 0x00, 0x0f, 0xff, 0xff, 0xff, 0xff, 0xf0, 0x00, 0x00, 0x0f, 0xff, 0xff,
//   0xff, 0xff, 0xf8, 0x00, 0x00, 0x1f, 0xff, 0xff, 0xff, 0xff, 0xf8, 0x00, 0x00, 0x1f, 0xff, 0xff,
//   0xff, 0xff, 0xfc, 0x00, 0x00, 0x3f, 0xff, 0xff, 0xff, 0xff, 0xfc, 0x00, 0x00, 0x3f, 0xff, 0xff,
//   0xff, 0xff, 0xfe, 0x00, 0x00, 0x7f, 0xff, 0xff, 0xff, 0xff, 0xfe, 0x00, 0x00, 0x7f, 0xff, 0xff,
//   0xff, 0xff, 0xff, 0x00, 0x00, 0xff, 0xff, 0xff, 0x9f, 0xff, 0xff, 0x0e, 0x70, 0xff, 0xff, 0xf9,
//   0x87, 0xff, 0xff, 0xfe, 0x7f, 0xff, 0xff, 0xe1, 0x81, 0xff, 0xff, 0xf8, 0x1f, 0xff, 0xff, 0x81,
//   0x80, 0x3f, 0xff, 0xf0, 0x0f, 0xff, 0xfe, 0x01, 0x80, 0x0f, 0xff, 0x80, 0x01, 0xff, 0xf0, 0x01,
//   0x80, 0x03, 0xfe, 0x00, 0x00, 0x7f, 0xc0, 0x01, 0x80, 0x00, 0xfe, 0x01, 0x80, 0x7f, 0x00, 0x01,
//   0x80, 0x00, 0x3c, 0x21, 0x84, 0x3c, 0x00, 0x01, 0x80, 0x00, 0x38, 0x31, 0x8c, 0x1c, 0x00, 0x01,
//   0x80, 0x00, 0x38, 0x29, 0x94, 0x1c, 0x00, 0x01, 0x80, 0x00, 0x30, 0x29, 0x94, 0x0c, 0x00, 0x01,
//   0x80, 0x00, 0x70, 0x28, 0x14, 0x0e, 0x00, 0x01, 0x80, 0x00, 0x70, 0x28, 0x14, 0x0e, 0x00, 0x01,
//   0x80, 0x00, 0x60, 0x29, 0x94, 0x06, 0x00, 0x01, 0x80, 0x00, 0x60, 0x2d, 0xb4, 0x06, 0x00, 0x01,
//   0x80, 0x00, 0x60, 0x29, 0x94, 0x06, 0x00, 0x01, 0x80, 0x00, 0x60, 0x33, 0xcc, 0x06, 0x00, 0x01,
//   0x80, 0x00, 0x70, 0x2e, 0x74, 0x0e, 0x00, 0x01, 0x80, 0x00, 0x78, 0x27, 0xe4, 0x1e, 0x00, 0x01,
//   0x80, 0x00, 0x30, 0x25, 0xa4, 0x0c, 0x00, 0x01, 0x80, 0x00, 0x30, 0x3f, 0xfc, 0x0c, 0x00, 0x01,
//   0x80, 0x00, 0x18, 0x07, 0xe0, 0x18, 0x00, 0x01, 0x80, 0x00, 0x3c, 0x03, 0xc0, 0x3c, 0x00, 0x01,
//   0x80, 0x00, 0xff, 0x03, 0xc0, 0xff, 0x00, 0x01, 0x80, 0x03, 0xff, 0x01, 0x80, 0xff, 0xc0, 0x01,
//   0x80, 0x0f, 0xff, 0x80, 0x01, 0xff, 0xf0, 0x01, 0x80, 0x3f, 0xff, 0xd3, 0xcb, 0xff, 0xfe, 0x01,
//   0x81, 0xff, 0xff, 0xff, 0xff, 0xff, 0xff, 0x81, 0x87, 0xff, 0xff, 0xff, 0xff, 0xff, 0xff, 0xe1,
//   0x9f, 0xff, 0xff, 0x0e, 0x70, 0xff, 0xff, 0xf9, 0xff, 0xff, 0xff, 0x00, 0x00, 0xff, 0xff, 0xff,
//   0xff, 0xff, 0xfe, 0x00, 0x00, 0x7f, 0xff, 0xff, 0xff, 0xff, 0xfe, 0x00, 0x00, 0x7f, 0xff, 0xff,
//   0xff, 0xff, 0xfc, 0x00, 0x00, 0x3f, 0xff, 0xff, 0xff, 0xff, 0xfc, 0x00, 0x00, 0x3f, 0xff, 0xff,
//   0xff, 0xff, 0xf8, 0x00, 0x00, 0x1f, 0xff, 0xff, 0xff, 0xff, 0xf8, 0x00, 0x00, 0x1f, 0xff, 0xff,
//   0xff, 0xff, 0xf8, 0x00, 0x00, 0x0f, 0xff, 0xff, 0xff, 0xff, 0xf0, 0x00, 0x00, 0x0f, 0xff, 0xff,
//   0xff, 0xff, 0xf0, 0x00, 0x00, 0x0f, 0xff, 0xff, 0xff, 0xff, 0xe0, 0x00, 0x00, 0x07, 0xff, 0xff,
//   0xff, 0xff, 0xe0, 0x00, 0x00, 0x07, 0xff, 0xff, 0xff, 0xff, 0xc0, 0x00, 0x00, 0x03, 0xff, 0xff,
//   0xff, 0xff, 0xc0, 0x00, 0x00, 0x03, 0xff, 0xff, 0xff, 0xff, 0x80, 0x00, 0x00, 0x01, 0xff, 0xff,
//   0xff, 0xff, 0x80, 0x00, 0x00, 0x01, 0xff, 0xff, 0xff, 0xff, 0xff, 0xff, 0xff, 0xff, 0xff, 0xff
// };
const unsigned char logoBitmap[] PROGMEM = {
  0x00, 0x00, 0x00, 0x00, 0x00, 0x00, 0x00, 0x00, 0x00, 0x00, 0x00, 0x00, 0x00, 0x00, 0x00, 0x00, 
	0x00, 0x00, 0x00, 0x00, 0x00, 0x00, 0x00, 0x00, 0x00, 0x00, 0x00, 0x00, 0x00, 0x00, 0x00, 0x00, 
	0x00, 0x00, 0x00, 0x00, 0x00, 0x00, 0x00, 0x00, 0x00, 0x00, 0x00, 0x00, 0x00, 0x30, 0x00, 0x00, 
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	0x00, 0x00, 0x00, 0x00, 0x00, 0x00, 0x00, 0x00, 0x00, 0x00, 0x00, 0x00, 0x00, 0x00, 0x00, 0x00
};
void drawDirectionArrows(MotorState state) {
  if (state == CCW) {
    display.fillTriangle(4, 32, 16, 24, 16, 40, 1);
  }

  if (state == CW) {
    display.fillTriangle(123, 32, 111, 24, 111, 40, 1);
  }
}

void drawAzimuthValue() {
  char realText[4];
  snprintf(realText, sizeof(realText), "%03d", getAzimuthDegrees());
  const char *errorText = getErrorSummary();
  const bool hasAnyError = getErrorFlags() != ERROR_NONE;

  if (hasError(ERROR_AZIMUTH)) {
    errorText = "AZIMUTH ERROR";
  }

  display.setTextColor(1);
  display.setTextWrap(false);
  display.setTextSize(1);
  const char *peerIp = uartLinkGetPeerIp();
  if (peerIp[0] != '\0') {
    display.setCursor(0, 0);
    display.print(peerIp);
  }

  display.setCursor(24, 8);
  display.println("ROTOR CTRL");
  display.setCursor(42, 16);
  // display.print("AZIMUTH");

  display.setTextSize(3);
  display.setCursor(37, 24);
  display.print(realText);

  if (hasAnyError) {
    display.setTextSize(1);
    display.setCursor(0, 54);
    display.print("ERR: ");
    display.print(errorText);
  }
}

void setDisplayPower(bool enabled) {
#if (CONFIG_OLED_1306 == 1)
  display.ssd1306_command(enabled ? SSD1306_DISPLAYON : SSD1306_DISPLAYOFF);
#endif

#if (CONFIG_OLED_1106 == 1)
  display.oled_command(enabled ? SH110X_DISPLAYON : SH110X_DISPLAYOFF);
#endif
}
}

void updateDisplay() {
  if (!displayReady) {
    return;
  }

  if (splashActive) {
    return;
  }

  if (displaySleeping) {
    setDisplayPower(true);
    displaySleeping = false;
  }

  display.clearDisplay();
  drawDirectionArrows(getMotorState());
  drawAzimuthValue();
  display.display();
}

void notifyDisplayActivity() {
  if (!displayReady) {
    return;
  }

  lastDisplayActivityMs = millis();

  if (displaySleeping) {
    updateDisplay();
  }
}

void displayLoop() {
  if (!displayReady) {
    return;
  }

  const uint32_t now = millis();

  if (splashActive) {
    if ((now - splashStartedMs) >= OLED_SPLASH_DELAY_MS) {
      splashActive = false;
      lastDisplayActivityMs = now;
      updateDisplay();
    }
    return;
  }

  if (getButtonMode() != BUTTON_IDLE) {
    lastDisplayActivityMs = now;
  }

  if (!displaySleeping && (now - lastDisplayActivityMs) >= OLED_IDLE_TIMEOUT_MS) {
    display.clearDisplay();
    display.display();
    setDisplayPower(false);
    displaySleeping = true;
    return;
  }

  if (displaySleeping) {
    return;
  }

  if ((now - lastDisplayRefreshMs) < OLED_REFRESH_MS) {
    return;
  }

  lastDisplayRefreshMs = now;
  updateDisplay();
}

void displayInit() {
  Wire.begin(PIN_OLED_SDA, PIN_OLED_SCL);

#if (CONFIG_OLED_1306 == 1)
  if (!display.begin(SSD1306_SWITCHCAPVCC, OLED_ADDRESS)) {
    Serial.println("[ERR] OLED SSD1306 init failed");
    setErrorState(ERROR_DISPLAY_INIT, true);
    return;
  }
#endif

#if (CONFIG_OLED_1106 == 1)
  if (!display.begin(OLED_ADDRESS, true)) {
    Serial.println("[ERR] OLED SH1106 init failed");
    setErrorState(ERROR_DISPLAY_INIT, true);
    return;
  }
#endif

#if (CONFIG_OLED_1306 == 0) && (CONFIG_OLED_1106 == 0)
  Serial.println("[ERR] OLED driver not selected");
  setErrorState(ERROR_DISPLAY_INIT, true);
  return;
#endif

  displayReady = true;
  setErrorState(ERROR_DISPLAY_INIT, false);
  display.clearDisplay();
  display.drawBitmap(32, 0, logoBitmap, 64, 64, 1);
  display.display();
  splashStartedMs = millis();
  lastDisplayActivityMs = splashStartedMs;
  splashActive = true;
  displaySleeping = false;
  lastDisplayRefreshMs = 0;
}
